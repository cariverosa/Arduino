// Librerias I2C para controlar el mpu6050
// la libreria MPU6050.h necesita I2Cdev.h, I2Cdev.h necesita Wire.h
#include "I2Cdev.h"
#include "MPU6050.h"
#include "Wire.h"
#include "Adafruit_GFX.h"
#include "Adafruit_SSD1306.h"

// La dirección del MPU6050 puede ser 0x68 o 0x69, dependiendo 
// del estado de AD0. Si no se especifica, 0x68 estará implicito
MPU6050 sensor;

// Valores RAW (sin procesar) del acelerometro y giroscopio en los ejes x,y,z
int ax, ay, az;
float potenciometro, distancia_1, distancia_2, Speed, distancia;
int pin_led_yellow = 5; 
int pin_led_red = 4;
int pin_buzzers = 6;
int pin_potenciometro = 0;
int timer = 100;
long duration;



#define echoPin 2
#define trigPin 3
#define SCREEN_WIDTH 128 
#define SCREEN_HEIGHT 64

#define OLED_RESET     -1 
#define SCREEN_ADDRESS 0x3C 
Adafruit_SSD1306 display(SCREEN_WIDTH, SCREEN_HEIGHT, &Wire, OLED_RESET);


const unsigned char PROGMEM logo [] = {
0x00, 0x00, 0x00, 0x00, 0x00, 0x00, 0x00, 0x00, 0x00, 0x00, 0x00, 0x00, 0x00, 0x00, 0x00, 0x00, 
0x00, 0x00, 0x00, 0x00, 0x00, 0x00, 0x00, 0x00, 0x00, 0x00, 0x00, 0x00, 0x00, 0x00, 0x00, 0x00, 
0x00, 0x00, 0x00, 0x00, 0x00, 0x00, 0x00, 0x00, 0x00, 0x00, 0x00, 0x00, 0x00, 0x00, 0x00, 0x00, 
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0x00, 0x00, 0x00, 0x00, 0x00, 0x00, 0x00, 0x00, 0x00, 0x00, 0x00, 0x00, 0x00, 0x00, 0x00, 0x00
};


void setup() {
  pinMode(pin_led_red, OUTPUT);
  pinMode(pin_led_yellow, OUTPUT);
  pinMode(pin_buzzers, OUTPUT);
  pinMode(trigPin, OUTPUT);
  pinMode(echoPin, INPUT);
  
  Serial.begin(57600);    //Iniciando puerto serial
  
  if(!display.begin(SSD1306_SWITCHCAPVCC, SCREEN_ADDRESS)) {
    Serial.println(F("SSD1306 allocation failed"));
    for(;;);
  } 
  if(!display.begin(SSD1306_SWITCHCAPVCC, 0x3C)) {
    Serial.println(F("SSD1306 allocation failed"));
    for(;;);
  }
  delay(2000);
  display.clearDisplay();
  display.setTextSize(1);
  display.setTextColor(WHITE);
  display.drawBitmap(0,0, logo, SCREEN_WIDTH, SCREEN_HEIGHT, WHITE);
  display.display();
  delay(1000);
  display.clearDisplay();
    
  Wire.begin();           //Iniciando I2C  
  sensor.initialize();    //Iniciando el sensor
  if (sensor.testConnection()) Serial.println("Sensor iniciado correctamente");
  else Serial.println("Error al iniciar el sensor");

  //sensor.setXAccelOffset(-3232);
  //sensor.setYAccelOffset(-103);
  //sensor.setZAccelOffset(16372);

  
}

void loop() {
  
  potenciometro = analogRead(pin_potenciometro);
  potenciometro = (5.0*potenciometro)/1024;

  distancia_1 = ultrasonicRead();
  delay(timer);
  distancia_2 = ultrasonicRead();
  Speed = (distancia_2 - distancia_1)/timer;
    
  sensor.getAcceleration(&ax, &ay, &az);
  
  //long AX = pow(ax,2);
  //long AY = pow(ay,2);
  //long AZ = pow(az,2);
  //long SUM = AX+AY+AZ;
  //double AT = sqrt(SUM);
  //float AT_1 = abs(AT-16384)/16384;
  float ax_1  = (ax-340)/16384.0; //Conversión a unidades de g, 1g = 16384.0
  float ay_1  = (ay-1300)/16384.0;
  float az_1  = (az-17700)/16384.0;

  float AX = pow(ax_1, 2);
  float AY = pow(ay_1, 2);
  float AZ = pow(az_1, 2);
  float SUM = AX + AY + AZ;
  float AT_1 = sqrt(SUM);
  

  if (AT_1 >=0.039 && AT_1<=0.092){
    tone(6, 400);
    delay(300);
    noTone(pin_buzzers); //Silencia el zumbador
    delay(300);  //Espera 500 ms antes de volver a sonar
    
    digitalWrite(pin_led_yellow,HIGH);
    delay(300);
    digitalWrite(pin_led_yellow,LOW);
    }
   else if (AT_1>0.092 && AT_1<=0.18){
    tone(6, 400);
    delay(100);
    noTone(pin_buzzers); //Silencia el zumbador
    delay(100);  //Espera 500 ms antes de volver a sonar
    
    digitalWrite(pin_led_yellow,HIGH);
    delay(100);
    digitalWrite(pin_led_yellow,LOW);

    digitalWrite(pin_led_red,HIGH);
    delay(100);
    digitalWrite(pin_led_red,LOW);
    }
   else if (AT_1>0.18){
    tone(6, 400);
    delay(300);
    noTone(pin_buzzers); //Silencia el zumbador
    delay(50);  //Espera 500 ms antes de volver a sonar
    digitalWrite(pin_led_red,HIGH);
    delay(300);
    digitalWrite(pin_led_red,LOW);
    }
  //Mostrar las lecturas separadas por un [tab]
  Serial.print("a[x y z xyz] V v:\t");
  Serial.print(ax_1); Serial.print("\t");
  Serial.print(ay_1); Serial.print("\t");
  Serial.print(az_1); Serial.print("\t");
  Serial.print(AX); Serial.print("\t");
  Serial.print(AY); Serial.print("\t");
  Serial.print(AZ); Serial.print("\t");
  Serial.print(AT_1); Serial.print("\t");
  Serial.print(potenciometro); Serial.print("\t");
  Serial.println(Speed); 
  delay(100);


  if (potenciometro>=4.0 && potenciometro<=5.0){
    display.setTextSize(1);
    display.setCursor(0,50);
    display.print("Voltaje: ");
    display.print(float(potenciometro));
    display.print("v");
    
    display.setTextSize(1);
    display.setCursor(0,0);
    display.print("Aceleracion x:  ");
    display.setTextSize(2);
    display.setCursor(0,10);
    display.print(ax_1);
    display.print(" g");
    display.display();
    display.clearDisplay();
    }
  else if (potenciometro>=3.0 && potenciometro<4.0){
    display.setTextSize(1);
    display.setCursor(0,50);
    display.print("Voltaje: ");
    display.print(float(potenciometro));
    display.print("v");
    
    display.setTextSize(1);
    display.setCursor(0,0);
    display.print("Aceleracion y:  ");
    display.setTextSize(2);
    display.setCursor(0,10);
    display.print(ay_1);
    display.print(" g");
    display.display();
    display.clearDisplay();
    }
  else if (potenciometro>=2.0 && potenciometro<3.0){
    display.setTextSize(1);
    display.setCursor(0,50);
    display.print("Voltaje: ");
    display.print(float(potenciometro));
    display.print("v");
    
    display.setTextSize(1);
    display.setCursor(0,0);
    display.print("Aceleracion z:  ");
    display.setTextSize(2);
    display.setCursor(0,10);
    display.print(az_1);
    display.print(" g");
    display.display();
    display.clearDisplay();
    }
   else{
    display.setTextSize(1);
    display.setCursor(0,50);
    display.print("Voltaje: ");
    display.print(float(potenciometro));
    display.print("v");
    
    display.setTextSize(1);
    display.setCursor(0,0);
    display.print("Aceleracion xyz:  ");
    display.setTextSize(2);
    display.setCursor(0,10);
    display.print(AT_1);
    display.print(" g");
    display.display();
    display.clearDisplay();

    if (AT_1 >=0.039 && AT_1<=0.092){
      display.setTextSize(1);
      display.setCursor(0,27);
      display.print("¡Terremoto moderado!");
      }
    else if (AT_1>0.092 && AT_1<=0.18){
      display.setTextSize(1);
      display.setCursor(0,27);
      display.print("¡Terremoto fuerte!");
      }
    else if (AT_1>0.18){
      display.setTextSize(1);
      display.setCursor(0,27);
      display.print("¡Terremoto extremo!");
      }
    else{
      display.setTextSize(1);
      display.setCursor(0,32);
      display.print("No hay terremoto :D");
      }
    }
}
float ultrasonicRead ()
{
// Clears the trigPin
digitalWrite(trigPin, LOW);
delayMicroseconds(2);

// Sets the trigPin on HIGH state for 10 micro seconds
digitalWrite(trigPin, HIGH);
delayMicroseconds(10);
digitalWrite(trigPin, LOW);

// Reads the echoPin, returns the sound wave travel time in microseconds
duration = pulseIn(echoPin, HIGH);

//calculating distance
distancia= duration*0.034/2;


return distancia;

}
